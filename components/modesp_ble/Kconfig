## components/modesp_ble/Kconfig
```kconfig
menu "ModESP BLE"

    config MODESP_BLE_ENABLE
        bool "Enable BLE (NimBLE) support"
        default n
        select BT_ENABLED
        select ESP_COEX_SW_COEXIST_ENABLE if ESP_WIFI_ENABLED
        help
            Master switch for the modesp_ble component (single NimBLE host owner).
            Pulls in the Bluetooth stack + Wi-Fi/BLE software coexistence.

            The NimBLE host (vs Bluedroid), core pinning and link buffers are set in
            sdkconfig.defaults.esp32s3 — those symbols are inert unless this option
            selects BT_ENABLED, so non-BLE builds are unaffected.

            Sub-features below compile independently (granular flash cost per board).

    config MODESP_BLE_PROVISIONING
        bool "BLE Wi-Fi/cloud provisioning (GATT)"
        depends on MODESP_BLE_ENABLE && MODESP_NET_ENABLE
        default n
        help
            GATT service to write Wi-Fi credentials / cloud config into NVS from a
            phone during headless setup. Reuses wifi_service reconnect — hence
            requires networking (MODESP_NET_ENABLE).

    config MODESP_BLE_GATT_SERVER
        bool "BLE telemetry/control GATT server (SharedState mirror)"
        depends on MODESP_BLE_ENABLE
        default n
        help
            GATT server exposing selected SharedState keys for local read (telemetry)
            and write (setpoints) without Wi-Fi. Manifest-driven key selection.

    config MODESP_BLE_CENTRAL
        bool "BLE central (scan external sensors / connect devices)"
        depends on MODESP_BLE_ENABLE
        default n
        help
            Passive-scan observer + optional connect/GATT. BLE drivers
            (hardware_type "ble") register advertisement decoders and connect
            profiles; the transport owns the radio and knows no device format.

endmenu
```

## components/modesp_can/Kconfig
```kconfig
menu "ModESP CAN"

    config MODESP_CAN_ENABLE
        bool "Enable CAN (TWAI) transport"
        default n
        help
            Master switch for the modesp_can component (single TWAI node owner).
            ModESP-CAN v1 (docs/can/ADR-004): SharedState export + event bridge
            between ModESP nodes over classic CAN 2.0B.

            Needs a board.json can_buses entry (tx/rx pins + bitrate) and an
            external CAN transceiver (SN65HVD230, TJA1051T/3 ...) on every node.
            The node's own address: NVS key can/node_id, MAC-derived by default.

            CAN bridge drivers (hardware_type "can", e.g. can_remote) depend on
            this option — their toggles auto-disable when it is off.

    config MODESP_CAN_SELF_TEST
        bool "CAN self-test mode (no-ACK loopback, single-node bench)"
        depends on MODESP_CAN_ENABLE
        default n
        help
            Enables the TWAI self-test + loopback flags: the node receives its
            own frames back without ACK, so the full TX->RX path is verifiable
            on ONE bench device without a transceiver or a second node.
            can.loopback_ok goes true after the first own frame round-trips.

            Never enable on a production bus (no-ACK violates CAN semantics).

endmenu
```

## components/modesp_net/Kconfig
```kconfig
menu "ModESP Network"

    config MODESP_NET_ENABLE
        bool "Enable networking (WiFi + HTTP + WebSocket)"
        default y
        help
            Master switch for the modesp_net component. When disabled, the
            component compiles empty (zero sources) and main.cpp skips the
            WiFi/HTTP/WebSocket wiring — for offline or BLE-only products.

            Disabling networking also removes OTA-over-HTTP; the OTA rollback
            watchdog then validates the firmware right after the main loop
            starts (no network health check available).

            Cloud backends (MQTT / AWS IoT) require this option.

endmenu
```

## components/modesp_scenario/Kconfig
```kconfig
menu "ModESP Scenario Engine"

    config MODESP_SCENARIO_ENABLE
        bool "Enable scenario engine (recipes / .modr runtime)"
        default y
        help
            Master switch for the modesp_scenario component (track-based
            time-dependent algorithm runtime). When disabled, the component
            compiles empty (zero sources), main.cpp skips the engine wiring
            and the /api/scenario/* HTTP endpoints are not registered.

            Products without recipe modules can disable this for a smaller
            binary.

endmenu
```

## components/modesp_sequence/Kconfig
```kconfig
menu "ModESP Sequence Engine"

    config MODESP_MAX_SEQUENCES
        int "Maximum concurrent scenario instances"
        range 1 8
        default 2
        help
            Number of slots в SequenceEngine pool. Each slot holds one
            loaded scenario (recipe). Per-slot static cost:
              - Buffer: MODESP_MODR_MAX_SIZE bytes (default 4 KB)
              - Runtime: ~600 bytes (state machine, dirty tracking)
            Total per slot: ~MODESP_MODR_MAX_SIZE + 1 KB.

            Default 2 = 2 concurrent scenarios. Bump only якщо ви маєте
            real use case (e.g. multiple zones running independent recipes
            у parallel). Each +1 slot costs ~5 KB RAM (із default sizes).

    config MODESP_MODR_MAX_SIZE
        int "Maximum .modr recipe binary size (bytes)"
        range 1024 32768
        default 4096
        help
            Pre-allocated buffer size per slot. Determines maximum recipe
            complexity (phases × tracks × actions × params) що fits.

            Typical sizes:
              - Minimal recipe (1 track, 1 phase): ~120 bytes
              - 2-track sync recipe: ~250 bytes
              - 3-phase abstract test (2 tracks): ~760 bytes
              - Complex 5-phase × 4-track із many actions: ~2-4 KB

            Default 4 KB covers most realistic recipes із headroom. Bump
            до 16 KB only якщо recipe author confirms size requirement.
            Larger value = more RAM used (4 KB × MODESP_MAX_SEQUENCES static).

endmenu
```
